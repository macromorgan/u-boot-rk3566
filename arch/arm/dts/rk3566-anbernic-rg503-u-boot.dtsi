// SPDX-License-Identifier: GPL-2.0+
/*
 * (C) Copyright 2021 Rockchip Electronics Co., Ltd
 */

#include "rk3568-u-boot.dtsi"

/ {

	aliases {
		mmc0 = &sdmmc0;
		mmc1 = &sdmmc1;
	};

	chosen {
		stdout-path = &uart2;
		u-boot,spl-boot-order = "same-as-spl", &sdmmc0;
	};
};

&uart2 {
	clock-frequency = <24000000>;
	u-boot,dm-spl;
	status = "okay";
};

/* The emmc controller and serial flash controller are not used. */
/delete-node/ &sdhci;
/delete-node/ &sfc;
